## src/sw/meta-sm-tsn-cfg3/conf/layer.conf
```bitbake
# We have a conf and classes directory, add to BBPATH
BBPATH .= ":${LAYERDIR}"
INHERIT += "buildhistory"
BUILDHISTORY_COMMIT = "1"


# We have recipes-* directories, add to BBFILES
BBFILES += "${LAYERDIR}/recipes-*/*/*.bb ${LAYERDIR}/recipes-*/*/*.bbappend"

BBFILE_COLLECTIONS += "meta-sm-tsn-cfg3"
BBFILE_PATTERN_meta-sm-tsn-cfg3 = "^${LAYERDIR}/"
BBFILE_PRIORITY_meta-sm-tsn-cfg3 = "21"

LAYERDEPENDS_meta-sm-tsn-cfg3 = "core meta-intel-fpga-refdes meta-intel-fpga"
LAYERSERIES_COMPAT_meta-sm-tsn-cfg3 = "master scarthgap"
BBDEBUG = "yes"
```
